## Config.in
```kconfig
source "$BR2_EXTERNAL_BARX_PATH/package/beep/Config.in"
source "$BR2_EXTERNAL_BARX_PATH/package/smem/Config.in"
```

## config/qemu_arm_barx_defconfig
```kconfig
BR2_arm=y
BR2_cortex_a9=y
BR2_ARM_ENABLE_NEON=y
BR2_ARM_ENABLE_VFP=y
BR2_PACKAGE_HOST_LINUX_HEADERS_CUSTOM_4_9=y
BR2_TOOLCHAIN_BUILDROOT_WCHAR=y
BR2_ROOTFS_DEVICE_CREATION_DYNAMIC_MDEV=y
BR2_TARGET_GENERIC_GETTY_PORT="ttyAMA0"
BR2_SYSTEM_DHCP="eth0"
BR2_ROOTFS_OVERLAY="$(BR2_EXTERNAL_BARX_PATH)/rootfs_overlay"
BR2_LINUX_KERNEL=y
BR2_LINUX_KERNEL_CUSTOM_VERSION=y
BR2_LINUX_KERNEL_CUSTOM_VERSION_VALUE="4.9.6"
BR2_LINUX_KERNEL_PATCH="$(BR2_EXTERNAL_BARX_PATH)/linux-patches"
BR2_LINUX_KERNEL_DEFCONFIG="vexpress"
BR2_LINUX_KERNEL_DTS_SUPPORT=y
BR2_LINUX_KERNEL_INTREE_DTS_NAME="vexpress-v2p-ca9"
BR2_PACKAGE_PYTHON=y
BR2_TARGET_ROOTFS_EXT2=y
# BR2_TARGET_ROOTFS_TAR is not set
BR2_PACKAGE_BEEP=y
BR2_PACKAGE_SMEM=y
BR2_PACKAGE_STORAGE=y
```

## package/beep/Config.in
```kconfig
config BR2_PACKAGE_BEEP
	bool "beep"
	help 
	 Play sounds from shell scripts

	 http://johnath.com/beep/
```

## package/smem/Config.in
```kconfig
config BR2_PACKAGE_SMEM
	bool "smem"
	depends on BR2_PACKAGE_PYTHON
	help 
	 smem is a tool that can give numerous reports on memory usage on Linux systems

	 https://www.selenic.com/smem/
```

## package/storage/Config.in
```kconfig
config BR2_PACKAGE_STORAGE
	bool "storage"
	depends on BR2_LINUX_KERNEL
	help 
	 test driver implementing small storage
```
